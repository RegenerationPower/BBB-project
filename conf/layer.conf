## conf/layer.conf
```bitbake
# We have a conf and classes directory, add to BBPATH
BBPATH .= ":${LAYERDIR}"

# We have recipes-* directories, add to BBFILES
BBFILES += "${LAYERDIR}/recipes-*/*/*.bb \
            ${LAYERDIR}/recipes-*/*/*.bbappend"

BBFILE_COLLECTIONS += "custom_layer"
BBFILE_PATTERN_custom_layer = "^${LAYERDIR}/"
BBFILE_PRIORITY_custom_layer = "6"

LAYERDEPENDS_custom_layer = "core"
LAYERSERIES_COMPAT_custom_layer = "scarthgap"
```
